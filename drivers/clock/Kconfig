## drivers/clock/Kconfig
```kconfig
#
# Copyright © 2020 The Crust Firmware Authors.
# SPDX-License-Identifier: BSD-3-Clause OR GPL-2.0-only
#

choice
	bool "OSC24M clock source"
	default OSC24M_SRC_DCXO if HAVE_DCXO
	default OSC24M_SRC_X24M

config OSC24M_SRC_DCXO
	bool "DCXO"
	depends on HAVE_DCXO
	help
		Select this option if your board has the 24 MHz crystal
		connected to the DCXO pads on the SoC.

config OSC24M_SRC_X24M
	bool "X24M"
	help
		Select this option if your board has the 24 MHz crystal
		connected to the X24M pads on the SoC.

endchoice
```

## drivers/dram/Kconfig
```kconfig
#
# Copyright © 2020-2021 The Crust Firmware Authors.
# SPDX-License-Identifier: BSD-3-Clause OR GPL-2.0-only
#

config HAVE_DRAM_SUSPEND
	bool
	help
		This option is selected on platforms that have the
		ability to suspend the DRAM controller.
```

## drivers/dvfs/Kconfig
```kconfig
#
# Copyright © 2017-2019 The Crust Firmware Authors.
# SPDX-License-Identifier: BSD-3-Clause OR GPL-2.0-only
#

config DVFS
	bool "DVFS support"
	depends on REGULATOR_AXP803 || REGULATOR_SY8106A
	help
		Enable control of the ARM CPU frequency at runtime. Do
		not select this option if you have a native DVFS driver
		in Linux, or if you have any other Linux driver that may
		attempt to communicate with the PMIC at runtime.
```

## drivers/irq/Kconfig
```kconfig
#
# Copyright © 2020 The Crust Firmware Authors.
# SPDX-License-Identifier: BSD-3-Clause OR GPL-2.0-only
#

menu "Interrupt and wakeup options"

config IRQ_POLL_EINT
	bool "Poll the GPIO controller for EINT IRQs"
	help
		Check the main GPIO controller (the one containing ports
		A through H) for external interrupts (EINTs) when
		polling for wakeup IRQs.

		This allows EINT-capable pins on those ports to be used
		as wakeup sources. The pins must be configured as EINT
		pins by Linux before entering suspend.

		Say Y if your board has a device connected to port A-H
		that must be able to wake up or turn on the system.
		Otherwise, say N.

if IRQ_POLL_EINT

config IRQ_POLL_EINT_FIRST_BANK
	int "First EINT bank to poll"
	range 0 7
	default 0
	help
		Begin the EINT polling loop at the nth EINT-capable GPIO
		bank, counting from 0. This number is not related to the
		GPIO bank letter.

config IRQ_POLL_EINT_LAST_BANK
	int "Last EINT bank to poll"
	range 0 7
	default 2 if PLATFORM_A64
	default 2 if PLATFORM_A83T
	default 7 if PLATFORM_H6
	help
		End the EINT polling loop at the nth EINT-capable GPIO
		bank, counting from 0. This number is not related to the
		GPIO bank letter.

endif

endmenu
```

## drivers/mfd/Kconfig
```kconfig
#
# Copyright © 2020 The Crust Firmware Authors.
# SPDX-License-Identifier: BSD-3-Clause OR GPL-2.0-only
#

config MFD_AXP20X
	bool
	default y
	depends on RSB

config MFD_AXP803
	bool
	default MFD_AXP20X
```

## drivers/misc/Kconfig
```kconfig
#
# Copyright © 2017-2018 The Crust Firmware Authors.
# SPDX-License-Identifier: BSD-3-Clause OR GPL-2.0-only
#

menu "Miscellaneous devices"

config GPIO_BUTTON
	bool "GPIO power button"

config GPIO_BUTTON_PIN
	int "GPIO power button pin number (Port L)"
	default 3
	depends on GPIO_BUTTON

endmenu
```

## drivers/pmic/Kconfig
```kconfig
#
# Copyright © 2017-2021 The Crust Firmware Authors.
# SPDX-License-Identifier: BSD-3-Clause OR GPL-2.0-only
#

menu "Power management controllers"

config PMIC
	bool

config PMIC_AXP803
	bool
	select PMIC
	default MFD_AXP803

config PMIC_AXP805
	bool
	select PMIC
	default MFD_AXP805

endmenu
```

## drivers/regmap/Kconfig
```kconfig
#
# Copyright © 2017-2021 The Crust Firmware Authors.
# SPDX-License-Identifier: BSD-3-Clause OR GPL-2.0-only
#

choice
	bool "I2C controller pin selection"
	depends on HAVE_I2C
	default I2C_PINS_NONE if HAVE_RSB
	default I2C_PINS_PL0_PL1
	help
		Choose which pair of pins is used for the I2C bus.

config I2C_PINS_NONE
	bool "None"
	help
		Select this option if your board does not have a PMIC or
		regulator connected via I2C.

		This is usually the right choice if your SoC supports RSB.

config I2C_PINS_PL0_PL1
	bool "PL0/PL1"
	help
		Select this option if your board has a PMIC or regulator
		connected via I2C using the normal set of pins.

		Note that if your SoC contains an RSB controller,
		choosing this option will prevent you from using it.

config I2C_PINS_PL8_PL9
	bool "PL8/PL9"
	depends on HAVE_RSB
	help
		Select this option if your board has a PMIC or regulator
		connected via I2C using the alternate set of pins.

endchoice

config I2C_PIN_MODE_PL0_PL1
	int
	depends on I2C_PINS_PL0_PL1
	default 3 if HAVE_RSB
	default 2
	help
		Provide the pin mode that configures PL0/PL1 as I2C SCL/SDA.

config I2C
	bool
	default HAVE_I2C && (!I2C_PINS_NONE || COMPILE_TEST)
	help
		This option is selected if the chosen pin configuration
		allows the I2C controller to be used.

config RSB
	bool
	default HAVE_RSB && (!I2C_PINS_PL0_PL1 || COMPILE_TEST)
	help
		This option is selected if the chosen pin configuration
		allows the RSB controller to be used.
```

## drivers/regulator/Kconfig
```kconfig
#
# Copyright © 2017-2021 The Crust Firmware Authors.
# SPDX-License-Identifier: BSD-3-Clause OR GPL-2.0-only
#

menu "Regulators (voltage/current)"

config REGULATOR_AXP803
	bool
	default MFD_AXP803

config REGULATOR_AXP805
	bool
	default MFD_AXP805

config REGULATOR_GPIO
	bool

menuconfig REGULATOR_GPIO_CPU
	bool "GPIO-controlled CPU power supply"
	select REGULATOR_GPIO
	help
		Select this option if your board supplies power to the
		CPU (VDD-CPUX) via a GPIO-controlled voltage regulator.

		This regulator will be disabled during both the suspend
		and shutdown procedures.

		Note: This GPIO pin must NOT also control VDD-SYS.
		VDD-SYS must remain powered while the system is asleep.

if REGULATOR_GPIO_CPU

config REGULATOR_GPIO_CPU_PIN
	int "GPIO pin (port L)"
	default 8
	range 0 31
	help
		Select the GPIO pin used to control the CPU supply.

endif

menuconfig REGULATOR_GPIO_DRAM
	bool "GPIO-controlled DRAM power supply"
	select REGULATOR_GPIO
	help
		Select this option if your board supplies power to the
		DRAM (VCC-DRAM) via a GPIO-controlled voltage regulator.

		This regulator will be disabled during the shutdown
		procedure.

if REGULATOR_GPIO_DRAM

config REGULATOR_GPIO_DRAM_PIN
	int "GPIO pin (port L)"
	default 9
	range 0 31
	help
		Select the GPIO pin used to control the DRAM supply.

endif

menuconfig REGULATOR_GPIO_VDD_SYS
	bool "GPIO-controlled VDD-SYS power supply"
	select REGULATOR_GPIO
	help
		Select this option if your board supplies power to the
		SoC (VDD-SYS) via a GPIO-controlled voltage regulator.

		This regulator will be disabled during the shutdown
		procedure.

if REGULATOR_GPIO_VDD_SYS

config REGULATOR_GPIO_VDD_SYS_PIN
	int "GPIO pin (port L)"
	default 8
	range 0 31
	help
		Select the GPIO pin used to control the VDD-SYS supply.

endif

config REGULATOR_SY8106A
	bool "Silergy SY8106A voltage regulator"
	depends on I2C

endmenu
```

## drivers/rsb/Kconfig
```kconfig
#
# Copyright © 2017-2019 The Crust Firmware Authors.
# SPDX-License-Identifier: BSD-3-Clause OR GPL-2.0-only
#

config RSB
	bool
	default y
	depends on SOC_A64
```

## drivers/serial/Kconfig
```kconfig
#
# Copyright © 2017-2021 The Crust Firmware Authors.
# SPDX-License-Identifier: BSD-3-Clause OR GPL-2.0-only
#

config HAVE_UART4
	bool
	help
		This option is selected on platforms that have a UART4.

config SERIAL
	bool "Serial input/output support"
	default y
	help
		Use a serial port (UART) for error logs and debugging.
		Note that depending on the port and options selected,
		this may interfere with other users of that serial port.

		If you are unsure, use the default port and baud rate.

		For maximum power savings, select the R_UART device or
		disable this option entirely.

if SERIAL

choice
	bool "Device"
	default SERIAL_DEV_UART0

config SERIAL_DEV_UART0
	bool "UART0"

config SERIAL_DEV_UART1
	bool "UART1"

config SERIAL_DEV_UART2
	bool "UART2"

config SERIAL_DEV_UART3
	bool "UART3"

config SERIAL_DEV_UART4
	bool "UART4"
	depends on HAVE_UART4

config SERIAL_DEV_R_UART
	bool "R_UART"

endchoice

config SERIAL_BAUD
	int "Baud" if !SERIAL_DEV_UART0
	range 0 1500000
	default 0 if SERIAL_DEV_UART0
	default 9600 if SERIAL_DEV_R_UART
	default 115200
	help
		If a positive number is entered, the firmware will set
		up the serial port with that baud rate before using it.

		If zero is entered, the firmware will assume the serial
		port is already configured and keep the existing baud
		rate. Use this option if the port is shared with other
		users.

endif
```

## drivers/watchdog/Kconfig
```kconfig
#
# Copyright © 2022 The Crust Firmware Authors.
# SPDX-License-Identifier: BSD-3-Clause OR GPL-2.0-only
#

choice
	bool "Watchdog timer"
	default WATCHDOG_SUN9I_A80_TWD if PLATFORM_H6
	default WATCHDOG_SUN6I_A31_WDT
	help
		The firmware is monitored by a watchdog timer. If an
		error occurs, the watchdog will reset the system instead
		of allowing it to hang.

		The watchdog also services user-requested system resets.

config WATCHDOG_SUN6I_A31_WDT
	bool "Watchdog (R_WDOG)"
	help
		This driver supports the watchdog in A31 and newer SoCs.

		This watchdog timer can reset the system after a minimum
		delay of one half second.

		Due to a bug in the H6 SoC, this watchdog timer hardware
		is used by other system software on that platform. When
		building for an H6 board, do not select this driver
		unless you know what you are doing.

config WATCHDOG_SUN9I_A80_TWD
	bool "Trusted watchdog (R_TWD)"
	depends on HAVE_R_TWD
	help
		This driver supports the trusted watchdog in A80 and
		newer SoCs.

		This watchdog timer can reset the system immediately.

		Older versions of Linux may interfere with this device,
		causing an unexpected reboot during system resume. As a
		workaround, select a different watchdog device.

endchoice
```

## platform/Kconfig
```kconfig
#
# Copyright © 2017-2022 The Crust Firmware Authors.
# SPDX-License-Identifier: BSD-3-Clause OR GPL-2.0-only
#

config PLATFORM
	string
	default "a64"  if PLATFORM_A64
	default "a83t" if PLATFORM_A83T
	default "h3"   if PLATFORM_H3
	default "h6"   if PLATFORM_H6

choice
	prompt "Platform selection"

config PLATFORM_A64
	bool "A64/H5"
	depends on ARCH_OR1K
	select HAVE_DRAM_SUSPEND

config PLATFORM_A83T
	bool "A83T"
	depends on ARCH_OR1K
	select HAVE_R_RSB
	select HAVE_UART4

config PLATFORM_H3
	bool "H3"
	depends on ARCH_OR1K
	select HAVE_DRAM_SUSPEND

config PLATFORM_H6
	bool "H6"
	depends on ARCH_OR1K
	select HAVE_DCXO
	select HAVE_DRAM_SUSPEND
	select HAVE_R_RSB

endchoice

source "a64/Kconfig"

config HAVE_DCXO
	bool
	help
		Select this option on platforms with a DCXO in the RTC
		domain in addition to X24M pads in the PLL domain.

config HAVE_DRAM_SUSPEND
	bool
	help
		Select this option on platforms with the ability to
		suspend the DRAM controller.

config HAVE_R_I2C
	bool
	default y
	help
		Select this option on platforms with an R_I2C controller.

config HAVE_R_RSB
	bool
	help
		Select this option on platforms with an RSB controller.

config HAVE_UART4
	bool
	help
		Select this option on platforms with a UART4.
```

## platform/a23/Kconfig
```kconfig
#
# Copyright © 2022 The Crust Firmware Authors.
# SPDX-License-Identifier: BSD-3-Clause OR GPL-2.0-only
#

if PLATFORM_A23

choice
	bool "SoC"

config SOC_A23
	bool "A23"
	select HAVE_UART4

config SOC_A33
	bool "A33"

endchoice

endif
```

## platform/a64/Kconfig
```kconfig
#
# Copyright © 2017-2020 The Crust Firmware Authors.
# SPDX-License-Identifier: BSD-3-Clause OR GPL-2.0-only
#

choice
	bool "SoC"

config SOC_A64
	bool "A64"

config SOC_H5
	bool "H5"

endchoice
```

## platform/a83t/Kconfig
```kconfig
#
# Copyright © 2019 The Crust Firmware Authors.
# SPDX-License-Identifier: BSD-3-Clause OR GPL-2.0-only
#

config SOC
	string
	default "A83T" if SOC_A83T

choice
	prompt "SoC"

config SOC_A83T
	bool "A83T"
	imply RSB

endchoice
```

## platform/sun50i/Kconfig
```kconfig
#
# Copyright © 2017-2018 The Crust Firmware Authors.
# SPDX-License-Identifier: BSD-3-Clause OR GPL-2.0-only
#

config SOC
	string
	default "A64" if SOC_A64
	default "H5" if SOC_H5

choice
	prompt "SoC"

config SOC_A64
	bool "A64"

config SOC_H5
	bool "H5"

endchoice
```
