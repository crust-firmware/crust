## Kconfig
```kconfig
#
# Copyright © 2017-2020 The Crust Firmware Authors.
# SPDX-License-Identifier: BSD-3-Clause OR GPL-2.0-only
#

mainmenu "Crust Firmware Configuration"

source "arch/Kconfig"
source "platform/Kconfig"
source "drivers/Kconfig"
source "common/debug/Kconfig"
```

## arch/Kconfig
```kconfig
#
# Copyright © 2020 The Crust Firmware Authors.
# SPDX-License-Identifier: BSD-3-Clause OR GPL-2.0-only
#

config ARCH
	string
	default "or1k" if ARCH_OR1K

config ARCH_OR1K
	bool
	default y
```

## common/Kconfig
```kconfig
#
# Copyright © 2017-2021 The Crust Firmware Authors.
# SPDX-License-Identifier: BSD-3-Clause OR GPL-2.0-only
#

menu "Firmware features"

config PMIC_SHUTDOWN
	bool "Use PMIC for full hardware shutdown"
	depends on PMIC
	default y
	help
		Command the PMIC to turn off all outputs during the
		shutdown procedure. This reduces power usage to almost
		zero, but also stops the firmware. In this state, only a
		power button connected directly to the PMIC can turn the
		system back on.

		If this option is disabled, the shutdown procedure will
		be implemented in software only (similar to the suspend
		procedure), so the firmware can turn the system back on.

		Say Y if your board is powered by a battery, or N if you
		need some other method of turning on the system, such as
		an IR remote control or a GPIO input.

endmenu

source "debug/Kconfig"
```

## common/debug/Kconfig
```kconfig
#
# Copyright © 2017-2022 The Crust Firmware Authors.
# SPDX-License-Identifier: BSD-3-Clause OR GPL-2.0-only
#

menu "Debugging options"

config ASSERT
	bool "Enable runtime assertion checking"
	default y
	help
		Enable assert() logic to validate assumptions and find
		bugs at runtime. If in doubt, say Y.

config ASSERT_VERBOSE
	bool "Verbose logging of assertion failures"
	depends on ASSERT
	help
		When an assertion fails, print detailed information
		about it to the console. This includes the expression
		that was checked, as well as the file and line number of
		the call to assert().

		The address of the failed assertion is printed with or
		without this option. Since all of the other details can
		be derived from the address and debug info (see below),
		enabling this option is only necessary when debug info
		is unavailable.

		Note that this option significantly increases the size
		of the final firmware binary. If in doubt, say N.

config COMPILE_TEST
	bool "Allow compiling a firmware that does not run"
	help
		Some combinations of options may not make sense or may
		not produce a functional firmware, for example if the
		firmware becomes too large, or if it contains multiple
		drivers for the same piece of hardware.

		This is mostly useful for development and automated
		testing. Users should say N.

config DEBUG_INFO
	bool "Compile the firmware with debug info"
	default y
	help
		When compiling the firmware, generate debug information
		for use with gdb. These are stripped out of the final
		firmware binary, so this option does not affect the
		loaded firmware size. If in doubt, say Y.

config DEBUG_LOG
	bool "Print additional debug-level log messages"
	help
		This enables the debug() logging macro to print verbose
		informational messages that may aid in debugging.

config DEBUG_MONITOR
	bool "Provide an interactive debug monitor while off/asleep"
	help
		While the system is off or asleep, accept simple commands
		on the serial port. Parsing is extremely basic, and line
		editing is not supported. Available commands are:
			m <address> [value] -- read/write memory
			w -- trigger wakeup

		With a PMIC present, additional commands are supported:
			p <address> [value] -- read/write PMIC registers

config DEBUG_MONITOR_PMIC
	bool
	depends on DEBUG_MONITOR
	default MFD_AXP20X

config DEBUG_PRINT_BATTERY
	bool "Print battery consumption periodically while off/asleep"
	depends on MFD_AXP223 || MFD_AXP803
	help
		While the system is off or asleep and the battery is
		discharging, print the battery voltage, discharge
		current, and calculated power usage every 30 seconds.

config DEBUG_PRINT_LATENCY
	bool "Print average latency after each state transition"
	help
		After each system state transition, calculate the
		average latency of the main loop, in AR100 clock cycles.
		The latency will be printed after the firmware has
		performed 10000 iterations in that state.

config DEBUG_PRINT_SPRS
	bool "Print the contents of Special Purpose Registers at boot"
	depends on ARCH_OR1K
	help
		The OpenRISC 1000 architecture defines various Special
		Purpose Registers, or SPRs, that describe the particular
		CPU implementation. Enable this option to print a subset
		of these SPRs in a human-readable format during boot.

config DEBUG_RECORD_STEPS
	bool "Record steps of the suspend/resume process in the RTC"
	depends on !PLATFORM_A83T # No RTC
	help
		Record the start of various steps of the suspend and
		resume processes in one of the RTC's general purpose
		registers. This provides an approximation of what the
		firmware was doing at the time of a hang. The last step
		will remain available in the RTC until a clean shutdown
		or reboot, or until power is removed.

config DEBUG_VERIFY_DRAM
	bool "Verify DRAM contents after controller resume"
	help
		After reinitializing the DRAM controller during system
		resume, verify that DRAM contents were preserved via a
		simple checksum.

		The algorithm is very simplistic, and only a small
		portion of DRAM is checked, so there is no guarantee
		that corruption will be detected.

endmenu
```

## configs/beelink_gs1_defconfig
```kconfig
CONFIG_PLATFORM_H6=y
CONFIG_CIR=y
CONFIG_CIR_PROTO_NEC=y
CONFIG_CIR_WAKE_CODE=0x8051
CONFIG_CIR_USE_OSC24M=y
CONFIG_MFD_AXP20X=y
```

## configs/beelink_x2_defconfig
```kconfig
CONFIG_PLATFORM_H3=y
CONFIG_CIR=y
CONFIG_CIR_PROTO_NEC=y
CONFIG_CIR_WAKE_CODE=0x8051
CONFIG_REGULATOR_GPIO_DRAM=y
```

## configs/orangepi_pc2_defconfig
```kconfig
CONFIG_SOC_H5=y
CONFIG_CIR=y
CONFIG_CIR_USE_OSC24M=y
CONFIG_REGULATOR_GPIO_DRAM=y
CONFIG_REGULATOR_SY8106A=y
```

## configs/tanix_tx6_defconfig
```kconfig
CONFIG_PLATFORM_H6=y
CONFIG_CIR=y
CONFIG_CIR_PROTO_NECX=y
CONFIG_CIR_WAKE_CODE=0x40404d
CONFIG_CIR_USE_OSC24M=y
```

## drivers/Kconfig
```kconfig
#
# Copyright © 2017-2021 The Crust Firmware Authors.
# SPDX-License-Identifier: BSD-3-Clause OR GPL-2.0-only
#

menu "Device drivers"

source "dram/Kconfig"
source "cir/Kconfig"
source "clock/Kconfig"
source "regmap/Kconfig"
source "mfd/Kconfig"
source "pmic/Kconfig"
source "regulator/Kconfig"
source "serial/Kconfig"

endmenu
```

## drivers/cec/Kconfig
```kconfig
#
# Copyright © 2021-2022 The Crust Firmware Authors.
# SPDX-License-Identifier: BSD-3-Clause OR GPL-2.0-only
#

config CEC
	bool "HDMI CEC"
	help
		Listen for messages from TV or other devices on HDMI CEC bus.
		This can be used as a wakeup source. Note: Clocks and resets
		must be pre-initialized by rich OS.
```

## drivers/cir/Kconfig
```kconfig
#
# Copyright © 2020-2021 The Crust Firmware Authors.
# SPDX-License-Identifier: BSD-3-Clause OR GPL-2.0-only
#

config CIR
	bool "CIR (infrared) receiver"
	help
		Listen for input from an infrared remote controller or
		keyboard. This can be used as a wakeup source.

if CIR

config CIR_WAKE_CODE
	hex "Scan code for wakeup"
	range 0x1 0xffffffff
	default 0x800f040c
	help
		Choose the scan code that will wake the system when detected.

		The default value will work with an RC6 MCE remote controller.

config CIR_CLK_RATE
	int
	default 125000 if CIR_USE_OSC24M # 24 MHz divided by 192
	default 32768
	help
		Provide the sample frequency used for protocol decoding.

config CIR_USE_OSC24M
	bool "Use OSC24M as parent clock"
	help
		Sometimes boards come without external 32768 Hz oscillator
		and thus RTC use the internal RC oscilator as a source
		for generating 32768 Hz clock. However, such clock is
		not precise enough for IR signal decoding purposes.

		Set this option to Y if your board doesn't have external
		32768 Hz oscillator. Note that this increases power
		consumption.

config R_CIR_RX_PIN
	int
	default  9 if PLATFORM_H6
	default 11 if PLATFORM_A64 || PLATFORM_H3
	default 12 if PLATFORM_A83T
	help
		Provide the Port L pin number used by the CIR receiver.

endif
```
